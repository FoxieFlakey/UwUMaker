## Kconfig
```kconfig
mainmenu "Test example"

config COMPILER_IS_CLANG
  bool "Hello"
  help
    Testing only
```

## sample/Kconfig
```kconfig
mainmenu "Hello"

config COMPILE_EXTRA
  bool "Compile extra?"

config SAY_HI_INSTEAD_HELLO
  bool "Say hi instead hello"
  depends on HELLO

config HELLO
  bool "Say hello"
  
```

## sample/app/Kconfig.app
```kconfig
config APP_ONLY_UWU
  bool "Hellooo"

config TEST_UWU
  bool "$[[make --version | head -1]]"
```
